// SPDX-License-Identifier: GPL-2.0-only
/*
 * zuma (Tensor G3) pin groups.
 *
 * Copyright 2020-2023 Google LLC
 */

#include "gs101-pinctrl.h"

&pinctrl_hsi2ufs {
	gph5: gph5-gpio-bank {
		gpio-controller;
		#gpio-cells = <2>;
		interrupt-controller;
		#interrupt-cells = <2>;
	};

	ufs_rst_n: ufs-rst-n-pins {
		samsung,pins = "gph5-1";
		samsung,pin-function = <GS101_PIN_FUNC_2>;
		samsung,pin-pud = <GS101_PIN_PULL_NONE>;
		samsung,pin-con-pdn = <GS101_PIN_PDN_PREV>;
		samsung,pin-pud-pdn = <GS101_PIN_PULL_NONE>;
	};

	ufs_refclk_out: ufs-refclk-out-pins {
		samsung,pins = "gph5-0";
		samsung,pin-function = <GS101_PIN_FUNC_2>;
		samsung,pin-pud = <GS101_PIN_PULL_NONE>;
		samsung,pin-con-pdn = <GS101_PIN_PDN_PREV>;
		samsung,pin-pud-pdn = <GS101_PIN_PULL_NONE>;
		samsung,pin-drv = <GS101_PIN_DRV_7_5_MA>;
	};
};
